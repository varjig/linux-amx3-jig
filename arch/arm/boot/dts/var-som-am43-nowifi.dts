/*
 * Copyright (C) 2014 Variscite LTD - http://www.variscite.com/
 *
 * This program is free software; you can redistribute it and/or modify
 * it under the terms of the GNU General Public License version 2 as
 * published by the Free Software Foundation.
 */

/* VAR-SOM-AM43 */

#include "var-som-am43.dtsi"

&am43xx_pinmux {
	pinctrl-0 = <&clkout2_pin &ddr3_vtt_toggle_default &debugss_pins &gpio_pins &wifi_gpio_pins>;

	wifi_gpio_pins: pinmux_wlan_pins_default {
		pinctrl-single,pins = <
			0x40 (PIN_INPUT | MUX_MODE7) /* gpmc_a0.gpio1[16] */
			0x44 (PIN_INPUT | MUX_MODE7) /* gpmc_a1.gpio1[17] */
			0x48 (PIN_INPUT | MUX_MODE7) /* gpmc_a2.gpio1[18] */
			0x4c (PIN_INPUT | MUX_MODE7) /* gpmc_a3.gpio1[19] */
			0x50 (PIN_INPUT | MUX_MODE7) /* gpmc_a4.gpio1[20] */
			0x54 (PIN_INPUT | MUX_MODE7) /* gpmc_a5.gpio1[21] */
			0x58 (PIN_INPUT | MUX_MODE7) /* gpmc_a6.gpio1[22] */
			0x5c (PIN_INPUT | MUX_MODE7) /* gpmc_a7.gpio1[23] */
			0x60 (PIN_INPUT | MUX_MODE7) /* gpmc_a8.gpio1[24] */
			0x64 (PIN_INPUT | MUX_MODE7) /* gpmc_a9.gpio1[25] */
			0x68 (PIN_INPUT | MUX_MODE7) /* gpmc_a10.gpio1[26] */
			0x6c (PIN_INPUT | MUX_MODE7) /* gpmc_a11.gpio1[27] */
			0x78 (PIN_INPUT | MUX_MODE7) /* gpmc_be1n.gpio1[28] */
			0x88 (PIN_INPUT | MUX_MODE7) /* gpmc_csn3.gpio2[0] */
			0x8c (PIN_INPUT | MUX_MODE7) /* gpmc_clk.gpio2[1] */
		>;
	};
};

